## conf/distro/gallus.conf
```bitbake
require conf/distro/fsl-imx-wayland.conf
include include/gallus-floating-rev.inc

DISTRO = "gallus"
DISTRO_NAME = "Vivint Gallus"
LICENSE_FLAGS_WHITELIST = "\
	non-commercial_netperf \
	commercial_ffmpeg \
	commercial_x264 \
"

DISTRO_FEATURES += " bluetooth"

IMX_DEFAULT_BSP = "nxp"

INHERIT += "extrausers"
EXTRA_USERS_PARAMS = "\
        usermod -P 'ap3x!' root; \
        "

IMAGE_FSTYPES = "ext4 wic.bz2 wic.bmap tar.xz"
VOLATILE_LOG_DIR = "no"

PACKAGE_CLASSES = "package_ipk"
EXTRA_IMAGE_FEATURES += "package-management read-only-rootfs"

PACKAGECONFIG_append_pn-gstreamer1.0-plugins-base = " opus"

BB_ENV_EXTRAWHITE=" \
	GIT_UBOOT_SERVER \
	GIT_UBOOT_BRANCH \
	GIT_UBOOT_PROTOCOL \
	GIT_UBOOT_REV \
	GIT_WALLSLY_UBOOT_SERVER \
	GIT_WALLSLY_UBOOT_BRANCH \
	GIT_WALLSLY_UBOOT_PROTOCOL \
	GIT_WALLSLY_UBOOT_REV \
	GIT_KERNEL_SERVER \
	GIT_KERNEL_BRANCH \
	GIT_KERNEL_PROTOCOL \
	GIT_KERNEL_REV \
	GIT_AUDIO_SERVER \
	GIT_AUDIO_BRANCH \
	GIT_AUDIO_PROTOCOL \
	GIT_AUDIO_REV \
	GIT_APPS_SERVER \
	GIT_APPS_BRANCH \
	GIT_APPS_PROTOCOL \
	GIT_APPS_REV \
	GIT_MONPWR_BRANCH_SLIMLINE \
	GIT_MONPWR_BRANCH_SKYHUB \
	GIT_MONPWR_BRANCH_WALLSLY \
	GIT_MONPWR_SERVER_SLIMLINE \
	GIT_MONPWR_SERVER_SKYHUB \
	GIT_MONPWR_SERVER_WALLSLY \
	GIT_MONPWR_PROTOCOL_SLIMLINE \
	GIT_MONPWR_PROTOCOL_SKYHUB \
	GIT_MONPWR_PROTOCOL_WALLSLY \
	GIT_MONPWR_REV_SLIMLINE \
	GIT_MONPWR_REV_SKYHUB \
	GIT_MONPWR_REV_WALLSLY \
	GIT_ARTIFACTS_BRANCH \
	GIT_ARTIFACTS_SERVER \
	GIT_ARTIFACTS_PROTOCOL \
	GIT_ARTIFACTS_REV \
	GIT_SIMLOCK_SERVER \
	GIT_SIMLOCK_PROTOCOL \
	GIT_SIMLOCK_BRANCH \
	GIT_SIMLOCK_REV \
	GIT_META_VIVINT_BRANCH \
	GIT_META_VIVINT_REV \
	GIT_LIVE555_BRANCH \
	GIT_LIVE555_SERVER \
	GIT_LIVE555_PROTOCOL \
	GIT_LIVE555_REV \
	GIT_LIVE555PROXY_BRANCH \
	GIT_LIVE555PROXY_SERVER \
	GIT_LIVE555PROXY_PROTCOL \
	GIT_LIVE555PROXY_REV \
	GIT_SERVER \
	LOCK_PORTS \
	REDUCE_LOGS \
	GIT_STRINGS_SERVER \
	SLIMLINE_VERSION \
	BY_PASS_UNIT_TEST \
	UPDATE_STRING_TABLE \
	"
```

## conf/distro/include/slimline-floating-rev.inc
```bitbake
GIT_UBOOT_BRANCH ?= "staging"
GIT_WALLSLY_UBOOT_BRANCH ?= "staging"
GIT_MONPWR_BRANCH_SLIMLINE ?= "staging"
GIT_MONPWR_BRANCH_SKYHUB ?= "skyhub-staging"
GIT_MONPWR_BRANCH_WALLSLY ?= "wallsly-staging"
GIT_KERNEL_BRANCH ?= "staging"
GIT_AUDIO_BRANCH ?= "staging"
GIT_APPS_BRANCH ?= "staging"
GIT_ARTIFACTS_BRANCH ?= "staging"
GIT_ARTIFACTS_LATEST_BRANCH ?= "feature/18.06_rel_3.20.3_pilot"
GIT_ZWAVE_BRANCH ?= "staging"
GIT_SIMLOCK_BRANCH ?= "master"
GIT_LIVE555_BRANCH ?= "staging"
GIT_LIVE555PROXY_BRANCH ?= "staging"
GIT_LIVE555PROXY_NGH_BRANCH ?= "ngh-staging"

GIT_UBOOT_REV ?= "${AUTOREV}"
GIT_WALLSLY_UBOOT_REV ?= "${AUTOREV}"
GIT_ARTIFACTS_REV ?= "${AUTOREV}"
GIT_ARTIFACTS_LATEST_REV ?= "${AUTOREV}"
GIT_ZWAVE_REV = "${AUTOREV}"
GIT_MONPWR_REV_SLIMLINE ?= "${AUTOREV}"
GIT_MONPWR_REV_SKYHUB ?= "${AUTOREV}"
GIT_MONPWR_REV_WALLSLY ?= "${AUTOREV}"
GIT_KERNEL_REV ?= "${AUTOREV}"
GIT_AUDIO_REV ?= "${AUTOREV}"
GIT_SIMLOCK_REV ?= "${AUTOREV}"
GIT_LIVE555_REV ?= "${AUTOREV}"
GIT_LIVE555PROXY_REV ?= "${AUTOREV}"
GIT_LIVE555PROXY_NGH_REV ?= "${AUTOREV}"
GIT_APPS_REV ?= "${AUTOREV}"
```

## conf/distro/include/vivint-floating-rev.inc
```bitbake
GIT_SERVER ?= "git@gitlab.com/vivint/horizontals/EM"
GIT_UBOOT_BRANCH ?= "staging"
GIT_UBOOT_NGH_BRANCH ?= "ngh-staging"
GIT_AUDIO_BRANCH ?= "staging"
GIT_APPS_BRANCH ?= "staging"
GIT_ARTIFACTS_BRANCH ?= "staging"
GIT_ZWAVE_BRANCH ?= "staging"
GIT_SIMLOCK_BRANCH ?= "master"
GIT_LIVE555_BRANCH ?= "staging"
GIT_LIVE555PROXY_BRANCH ?= "staging"

GIT_UBOOT_REV ?= "${AUTOREV}"
GIT_NGH_UBOOT_REV ?= "${AUTOREV}"
GIT_ARTIFACTS_REV ?= "${AUTOREV}"
GIT_ZWAVE_REV = "${AUTOREV}"
GIT_KERNEL_REV ?= "${AUTOREV}"
GIT_KERNEL_NGH_REV ?= "${AUTOREV}"
GIT_AUDIO_REV ?= "${AUTOREV}"
GIT_SIMLOCK_REV ?= "${AUTOREV}"
GIT_LIVE555_REV ?= "${AUTOREV}"
GIT_LIVE555PROXY_REV ?= "${AUTOREV}"
GIT_APPS_REV ?= "${AUTOREV}"
```

## conf/distro/magellan-wayland.conf
```bitbake
require conf/distro/fsl-imx-wayland.conf
include include/gallus-floating-rev.inc

DISTRO = "magellan-wayland"
DISTRO_NAME = "Vivint Magellan"
LICENSE_FLAGS_WHITELIST = "\
	non-commercial_netperf \
	commercial_ffmpeg \
	commercial_x264 \
"

DISTRO_FEATURES += " bluetooth systemd"
VIRTUAL-RUNTIME_init_manager = "systemd"

IMX_DEFAULT_BSP = "nxp"

INHERIT += "extrausers"
EXTRA_USERS_PARAMS = "\
        usermod -P 'ap3x!' root; \
        "

IMAGE_FSTYPES = "ext4 wic.bz2 wic.bmap tar.xz"
VOLATILE_LOG_DIR = "no"

PACKAGE_CLASSES = "package_ipk"
EXTRA_IMAGE_FEATURES += "package-management"

PACKAGECONFIG_append_pn-gstreamer1.0-plugins-base = " opus"
PACKAGECONFIG_remove_pn-vim = " x11"
```

## conf/distro/nene-wayland.conf
```bitbake
require conf/distro/fsl-imx-wayland.conf
include include/gallus-floating-rev.inc

DISTRO = "nene-wayland"
DISTRO_NAME = "Vivint BSP Nene"
SLIMLINE_VERSION ?= "${DATETIME}"
SLIMLINE_VERSION[vardepsexclude] = "DATETIME"
DISTRO_VERSION = "${SLIMLINE_VERSION}"
IMAGE_NAME = "${IMAGE_BASENAME}-${MACHINE}-${SLIMLINE_VERSION}"

LICENSE_FLAGS_WHITELIST = "\
	non-commercial_netperf \
	commercial_ffmpeg \
	commercial_x264 \
"

DISTRO_FEATURES += " bluetooth systemd"
VIRTUAL-RUNTIME_init_manager = "systemd"

IMX_DEFAULT_BSP = "nxp"

INHERIT += "extrausers"
EXTRA_USERS_PARAMS = "\
        usermod -P 'ap3x!' root; \
        "

IMAGE_FSTYPES = "ext4 wic.bz2 wic.bmap tar.xz"
VOLATILE_LOG_DIR = "no"

PACKAGE_CLASSES = "package_ipk"
EXTRA_IMAGE_FEATURES += "package-management"

PACKAGECONFIG_append_pn-gstreamer1.0-plugins-base = " opus"
PACKAGECONFIG_append_pn-gstreamer1.0-plugins-bad = " opusparse"

COPY_LIC_MANIFEST = "1"
COPY_LIC_DIRS = "1"
LICENSE_CREATE_PACKAGE = "1"
```

## conf/distro/slimline.conf
```bitbake
require conf/distro/poky.conf
DISTRO = "slimline"
DISTRO_NAME = ""
GLANCE_NAME = "Glance"
SKYHUB_NAME = "SkyHub"
WALLSLY_NAME = "WallSly"
BRAZEN_NAME = "Brazen"
SLIMLINE_VERSION ?= "${DATETIME}"
SLIMLINE_VERSION[vardepsexclude] = "DATETIME"
DISTRO_VERSION = "${SLIMLINE_VERSION}"
BUILDNAME = "${DISTRO_NAME} ${DISTRO_VERSION}"
IMAGE_NAME = "${IMAGE_BASENAME}-${MACHINE}-${DISTRO_VERSION}"
REPO_MANIFEST ?= "develop" 
LICENSE_FLAGS_WHITELIST = "\
	non-commercial_netperf \
	commercial_gstreamer1.0-plugins-ugly \
	commercial_gst-ffmpeg \
	commercial_ffmpeg \
	commercial_x264 \
	commercial_libmad \
	commercial_mpeg2dec \
	commercial_lame \
    commercial_python3-pyqt5 \
"

PACKAGECONFIG_append_pn-qtbase= " sql-sqlite accessibility gif"
PACKAGECONFIG_append_pn-qtbase= " eglfs" 
PACKAGECONFIG_append_pn-qtbase= " gles2"

PACKAGECONFIG_append_pn-qtmultimedia= " gstreamer"
PACKAGECONFIG_append_pn-pulseaudio= " webrtc"
PACKAGECONFIG_append_pn-ffmpeg= " vpx"

PACKAGECONFIG_append_pn-gstreamer1.0-plugins-base = " opus"
PACKAGECONFIG_append_pn-gstreamer1.0-plugins-bad = " opusparse"

PACKAGECONFIG_remove_pn-gstreamer1.0-plugins-bad = " vulkan"

PACKAGECONFIG_append_pn-weston = " kms fbdev wayland egl"

# Set the root password
ROOT_PASSWORD="ap3x!"
INHERIT += "extrausers"
EXTRA_USERS_PARAMS="usermod -p `openssl passwd ${ROOT_PASSWORD}` root;"

COPY_LIC_MANIFEST = "1"
COPY_LIC_DIRS = "1"

PREFERRED_VERSION_pulseaudio = "11.1"
VOLATILE_LOG_DIR = "no"

PRSERV_HOST = "localhost:0"
RM_OLD_IMAGE = "1"

RM_WORK_EXCLUDE += "sly-qt5-image slimline-qt5-image"

require include/slimline-floating-rev.inc

DISTRO_FEATURES_append = " wayland"
```

## conf/distro/sprouter.conf
```bitbake
require conf/distro/poky.conf
DISTRO = "sprouter"
DISTRO_NAME = "Sprouter (Vivint Space Monkey Router Yocto Distro)"
DISTRO_VERSION = "0.0.1"

#PYTHON_BASEVERSION ?= "3.3"
#PREFERRED_VERSION_python3 ?= "3.3.3"
#PREFERRED_VERSION_python-native ?= "2.7.3"
```

## conf/distro/vivint-pegasus.conf
```bitbake
require conf/distro/fsl-imx-wayland.conf

DISTRO = "vivint-pegasus"
DISTRO_NAME = "Vivint Pegasus BSP"

LICENSE_FLAGS_ACCEPTED = " \
	non-commercial_netperf \
	commercial_ffmpeg \
	commercial_x264 \
"

DISTRO_FEATURES += " bluetooth systemd"
VIRTUAL-RUNTIME_init_manager = "systemd"

INHERIT += "extrausers"
RPASSWD = '\$5\$7BoYcT7ja500bcQr\$w2pd8tEIL3W1yVFGSnZb4/yYoQ9/ImQb15274959GKB'
VPASSWD = '\$5\$JKYAM4W1bQMdvoKz\$WyIYyAmxr.KiUBw3WX790QQYvhF64Ie3FHUeRrc2vV8'
EXTRA_USERS_PARAMS = "\
    useradd -p '${VPASSWD}' vivint; \
    usermod -p '${RPASSWD}' root; \
"

IMAGE_FSTYPES = "wic.zst wic.bmap tar.xz cpio.gz.u-boot"
VOLATILE_LOG_DIR = "no"

PACKAGE_CLASSES = "package_ipk"
EXTRA_IMAGE_FEATURES += "package-management"

COPY_LIC_MANIFEST = "1"
COPY_LIC_DIRS = "1"
LICENSE_CREATE_PACKAGE = "1"
```

## conf/distro/vivint-wayland.conf
```bitbake
require conf/distro/fsl-imx-wayland.conf
include include/vivint-floating-rev.inc

DISTRO = "vivint-wayland"
DISTRO_NAME = "Vivint BSP"

LICENSE_FLAGS_ACCEPTED = " \
	non-commercial_netperf \
	commercial_ffmpeg \
	commercial_x264 \
"

DISTRO_FEATURES += " bluetooth systemd"
VIRTUAL-RUNTIME_init_manager = "systemd"

INHERIT += "extrausers"
RPASSWD = '\$5\$7BoYcT7ja500bcQr\$w2pd8tEIL3W1yVFGSnZb4/yYoQ9/ImQb15274959GKB'
EXTRA_USERS_PARAMS = "\
    useradd vivint; \
    usermod -p '${RPASSWD}' root; \
"

IMAGE_FSTYPES = "wic.zst wic.bmap tar.xz cpio.gz.u-boot"
VOLATILE_LOG_DIR = "no"

PACKAGE_CLASSES = "package_ipk"
EXTRA_IMAGE_FEATURES += "package-management"

PACKAGECONFIG:append:pn-gstreamer1.0-plugins-base = " opus"
PACKAGECONFIG:append:pn-gstreamer1.0-plugins-bad = " opusparse"
PACKAGECONFIG:remove:pn-vim = " x11"

COPY_LIC_MANIFEST = "1"
COPY_LIC_DIRS = "1"
LICENSE_CREATE_PACKAGE = "1"
```

## conf/machine/imx6dl-slimline.conf
```bitbake
#@TYPE: Machine
#@NAME: Slimline i.MX6DL Slimline
#@SOC: i.MX6DL
#@DESCRIPTION: Machine configuration for Vivint i.MX6DL Slimline Panel

MACHINEOVERRIDES = "mx6:mx6dl:"

require conf/machine/include/imx-base.inc
require conf/machine/include/tune-cortexa9.inc

MACHINE_FEATURES += " pci wifi"

KERNEL_DEVICETREE = "imx6dl-slimline-ldo.dtb"
KERNEL_DEVICETREE += "imx6dl-slimline-ldo-nofec.dtb"
KERNEL_DEVICETREE += "imx6dl-sly-v2-ldo.dtb"
KERNEL_DEVICETREE += "imx6dl-sly-v3-ldo.dtb"
KERNEL_DEVICETREE += "imx6dl-wallsly-ldo.dtb"
KERNEL_DEVICETREE += "imx6dl-wallsly-net-ldo.dtb"
KERNEL_DEVICETREE += "imx6dl-wallsly-v3-ldo.dtb"
KERNEL_DEVICETREE += "imx6dl-wallsly-v4-ldo.dtb"
KERNEL_DEVICETREE += "imx6dl-wallsly-v6-ldo.dtb"

SERIAL_CONSOLE = "115200 ttymxc2"

MACHINE_FIRMWARE += "\
	linux-firmware-ar3k \
	linux-firmware-ar9170 \
	linux-firmware-ath6k \
	linux-firmware-ath9k \
	linux-firmware-bcm4329 \
	linux-firmware-bcm4330 \
	linux-firmware-bcm4334 \
	linux-firmware-iwlwifi-135-6 \
	linux-firmware-iwlwifi-6000g2a-5 \
	linux-firmware-iwlwifi-6000g2a-6 \
	linux-firmware-iwlwifi-6000g2b-6 \
	linux-firmware-iwlwifi-7260-7 \
	linux-firmware-radeon \
	linux-firmware-ralink \
	linux-firmware-rtl8192ce \
	linux-firmware-rtl8192cu \
	linux-firmware-rtl8192su \
	linux-firmware-sd8686 \
	linux-firmware-sd8787 \
	linux-firmware-sd8797 \
	linux-firmware-vt6656 \
	linux-firmware-wl12xx \
	linux-firmware-wl18xx \
	"

UBOOT_CONFIG ??= "${@bb.utils.contains('MACHINE_FEATURES', 'optee', 'sd-optee', 'sd', d)}"
UBOOT_CONFIG[sd] = "mx6dlslimline_config,sdcard"

WKS_FILE = "slimline.wks.in"

IMAGE_BOOTLOADER = "imx-boot"
```

## conf/machine/imx6dl-sprouter.conf
```bitbake
#@TYPE: Machine
#@NAME: Sprouter i.MX6DL Sprouter
#@SOC: i.MX6DL
#@DESCRIPTION: Machine configuration for Vivint i.MX6DL Space Monkey Router Panel

include conf/machine/include/imx-base.inc
include conf/machine/include/tune-cortexa9.inc

SOC_FAMILY = "mx6:mx6dl"

PREFERRED_PROVIDER_virtual/kernel = "linux-sprouter"

UBOOT_MACHINE = "mx6dlsprouter_config"

KERNEL_DEVICETREE = "imx6dl-sprouter-ldo.dtb"

SERIAL_CONSOLE = "115200 ttymxc2"

MACHINE_FEATURES += " pci"

MACHINE_EXTRA_RRECOMMENDS += " linux-firmware-rtl8192ce"

IMAGE_CLASSES += "image_types_uboot"

IMAGE_FSTYPES += " ext4.gz.u-boot"

PREFERRED_PROVIDER_u-boot_mx6 = "u-boot-sprouter"

PREFERRED_PROVIDER_virtual/kernel_mx6 = "linux-sprouter"

# Ensure boot scripts will be available at rootfs time
do_rootfs[depends] += "u-boot-script-sprouter:do_deploy"

# u-boot-sprouter: /etc/fw_env.config
IMAGE_INSTALL_append = "  u-boot-sprouter"
```

## conf/machine/imx8mn-pegasus.conf
```bitbake
#@TYPE: Machine
#@NAME: NXP i.MX 8M Nano Evaluation Kit with LPDDR4
#@SOC: i.MX8MN
#@DESCRIPTION: Machine configuration for NXP i.MX 8M Nano EVK with LPDDR4
#@MAINTAINER: Jun Zhu <junzhu@nxp.com>

require conf/machine/include/imx8mn-evk.inc

# The device tree name is implicit for LPDDR4, so can't use MACHINE here
KERNEL_DEVICETREE_BASENAME = "imx8mn-evk"
KERNEL_DEVICETREE:append:use-nxp-bsp = " \
    freescale/${KERNEL_DEVICETREE_BASENAME}-inmate.dtb \
    freescale/${KERNEL_DEVICETREE_BASENAME}-root.dtb \
    freescale/${KERNEL_DEVICETREE_BASENAME}-usd-wifi.dtb \
    freescale/${KERNEL_DEVICETREE_BASENAME}-8mic-revE.dtb \
    freescale/${KERNEL_DEVICETREE_BASENAME}-8mic-swpdm.dtb \
"

KERNEL_MODULE_AUTOLOAD += "moal"
KERNEL_MODULE_PROBECONF += "moal"
module_conf_moal = "options moal mod_para=nxp/wifi_mod_para.conf"

UBOOT_CONFIG_BASENAME = "imx8mn_evk"
DDR_FIRMWARE_NAME = " \
    lpddr4_pmu_train_1d_imem.bin \
    lpddr4_pmu_train_1d_dmem.bin \
    lpddr4_pmu_train_2d_imem.bin \
    lpddr4_pmu_train_2d_dmem.bin \
"
IMXBOOT_TARGETS_BASENAME = "flash_evk"

# Mainline BSP doesn't support LPDDR4 so it must be set to nxp.
# Also this machine isn't supported by u-boot-fslc but imx8mn-evk.inc already
# set the bootloader to u-boot-imx instead when NXP BSP is used.
IMX_DEFAULT_BSP = "nxp"

# Set this to get rid of a warning
QEMUVERSION              = "8.2.7"

# Multilib setup
require conf/multilib.conf
MULTILIBS = "multilib:lib32"
DEFAULTTUNE:virtclass-multilib-lib32 = "armv7athf-neon"

WKS_FILE = "pegasus.wks.in"

IMAGE_BOOT_FILES:append = " \
    boot.scr-${MACHINE};boot.scr \
"

WKS_FILE_DEPENDS += "u-boot-script-vivint"

FILESYSTEM_PERMS_TABLES:append = " files/fs-perms-vivint.txt"
```
